#include <stdarg.h>

#define RST A0
#define WAIT 8
#define WR 9
#define RD 10
#define HALT 6
#define MREQ 11
#define IORQ 7
#define CLK A7
#define NMI 5
#define IRQ 4
#define NMI_BTN 2
#define IRQ_BTN 3

#define UART_PORT 1
#define UART_BUFSZ_PORT 2
#define PROGBUF_PORT 3
#define PROGBUFSZ_LOW_PORT 4
#define PROGBUFSZ_HIGH_PORT 5
#define RNG_PORT 6

#define PROG_START1 0xed
#define PROG_START2 0x33
#define PROG_END1 0xed
#define PROG_END2 0x8c
#define PROG_ACK 0x48
#define PROG_NACK 0x7d
#define PROG_END_ACK 0xa9
#define PROGMODE_LED 13

bool progmode = false;
bool progstart1 = false;
bool progend1 = false;
bool setIRQ = false;
bool setNMI = false;

uint8_t ram[0x200] = {
0x31, 0xff, 0xff, 0xc3, 0x68, 0x00, 0x00, 0x00, 
0x00, 0x00, 0x00, 0x00, 0x00, 0x00, 0x00, 0x00, 
0x00, 0x00, 0x00, 0x00, 0x00, 0x00, 0x00, 0x00, 
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0xf3, 0x01, 0xc9, 0x00, 0x00, 

};

uint8_t progbuf[0x800] = {0};
int progbufptr = 0;
uint16_t progbufsz = 0;

char input_buf[0x100] = {0};
int input_bufsz = 0;
int input_bufptr = 0;

void print(const char *fmt, ...) {
  char buf[0x200] = {0};

  va_list args;
  va_start(args, fmt);
  vsprintf(buf, fmt, args);
  va_end(args);

  Serial.print(buf);
}

uint16_t getAddr() {
  uint16_t addr = 0;

  for (int i = 0; i < 15; i++) {
    addr |= (digitalRead(i*2+22) << i);
  }

  return addr;
}

void setDataMode(int mode) {
  for (int i = 0; i < 8; i++) {
    pinMode(23 + i*2, mode);
  }
}

void setData(uint8_t data) {
  for (int i = 0; i < 8; i++) {
    digitalWrite(23+i*2, !!(data & (1 << i)));
  }
}

uint8_t getData() {
  uint8_t data = 0;

  for (int i = 0; i < 8; i++) {
    data |= (digitalRead(23+i*2) << i);
  }

  return data;
}

void setup() {
  Serial.begin(115200);
  Serial1.begin(115200);
  Serial1.setTimeout(1000);

  randomSeed(micros() + (analogRead(A15) ^ analogRead(A10)));

  for (int i = 0; i < 16; i++) {
    pinMode(22+i*2, INPUT);
  }

  for (int i = 0; i < 8; i++) {
    pinMode(23+i*2, INPUT);
  }

  pinMode(WAIT, OUTPUT);
  digitalWrite(WAIT, HIGH);

  pinMode(WR, INPUT);
  pinMode(RD, INPUT);
  pinMode(HALT, INPUT);
  pinMode(MREQ, INPUT);
  pinMode(IORQ, INPUT);
  pinMode(NMI, OUTPUT);
  pinMode(IRQ, OUTPUT);
  digitalWrite(NMI, HIGH);
  digitalWrite(IRQ, HIGH);
  pinMode(IRQ_BTN, INPUT);
  pinMode(NMI_BTN, INPUT);
  attachInterrupt(digitalPinToInterrupt(IRQ_BTN), handleIRQ, FALLING);
  attachInterrupt(digitalPinToInterrupt(NMI_BTN), handleNMI, FALLING);
  pinMode(PROGMODE_LED, OUTPUT);
  digitalWrite(PROGMODE_LED, LOW);
}

void handleIRQ() {
  static uint32_t debounce = millis();
  if (millis() - debounce > 500) {
    setIRQ = true;
    debounce = millis();
  }
}

void handleNMI() {
  static uint32_t debounce = millis();
  if (millis() - debounce > 500) {
    setNMI = true;
    debounce = millis();
  }
}

void loop() {
  static uint32_t debounce = millis();
  static uint32_t nmiDebounce = millis();
  static bool processed = false;

  if (setNMI) {
    setNMI = false;
    digitalWrite(NMI, LOW);
    delay(100);
    digitalWrite(NMI, HIGH);
    return;
  }

  if (setIRQ) {
    setIRQ = false;
    digitalWrite(IRQ, LOW);
    delay(100);
    digitalWrite(IRQ, HIGH);
    return;
  }

  if (!digitalRead(MREQ)) {
    uint16_t addr = getAddr();

    if (!digitalRead(RD)) {
      setDataMode(OUTPUT);
      setData(ram[addr]);

      while (!digitalRead(RD));
      setDataMode(INPUT);
    }

    if (!digitalRead(WR)) {
      uint8_t data = getData();
      ram[addr] = data;
      while (!digitalRead(WR));
    }
  }

  if (!digitalRead(IORQ)) {
    uint8_t addr = getAddr() & 0xff;

    if (!digitalRead(WR)) {
      digitalWrite(WAIT, LOW);
      if (addr == UART_PORT && !processed) {
        print("%c", (char) getData());
        Serial.flush();
        processed = true;

      } else if (addr == UART_BUFSZ_PORT && !processed) {
        Serial.flush();
        input_bufsz = 0;
        input_bufptr = 0;
        processed = true;

      }
      digitalWrite(WAIT, HIGH);
    } else {
      processed = false;
    }

    if (!digitalRead(RD)) {
      digitalWrite(WAIT, LOW);
      setDataMode(OUTPUT);

      if (addr == UART_BUFSZ_PORT && !processed) {
        setData((uint8_t) input_bufsz);

      } else if (addr == UART_PORT && !processed) {
        if (input_bufptr < input_bufsz) {
          setData(input_buf[input_bufptr++]);
        } else {
          setData(0);
        }

      } else if (addr == PROGBUFSZ_LOW_PORT && !processed) {
        setData((uint8_t) (progbufsz & 0xff));

      } else if (addr == PROGBUFSZ_HIGH_PORT && !processed) {
        setData((uint8_t) (progbufsz >> 8));

      } else if (addr == PROGBUF_PORT && !processed) {
        if (progbufptr == progbufsz - 1) {
          setData(progbuf[progbufptr++]);
          progbufsz = 0;
          progbufptr = 0;
        } else if (progbufptr < progbufsz) {
          setData(progbuf[progbufptr++]);
        } else {
          setData(0);
        }

      } else if (addr == RNG_PORT && !processed) {
        setData((uint8_t) random(0, 0x100));
      }

      digitalWrite(WAIT, HIGH);
      while (!digitalRead(RD));
      setDataMode(INPUT);
    }
  } else {
    processed = false;
  }

  digitalWrite(WAIT, LOW);
  if (millis() - debounce > 1000) {
    //print("(%u) progbufsz=%d ptr=%d\n", millis(), 1, progbufsz, progbufptr);
    //Serial.println(millis());

    /*
    for (int i = 0;i < progbufsz; i++) {
      Serial.print(progbuf[i]);
      Serial.print(" ");
    }
    Serial.println();
    */

    debounce = millis();
  }

  if (Serial.available()) {
    String s = Serial.readString();
    char *str = s.c_str();
    strcpy(input_buf, str);
    input_bufsz = strlen(str);
    input_bufptr = 0;
  }

  if (Serial1.available()) {
    uint8_t c = Serial1.read();

    if (!progstart1) {
      if (c == 0xed) {
        progstart1 = true;
        Serial1.write(PROG_ACK);

      } else {
        progstart1 = false;
        Serial1.write(PROG_NACK);
      }
    } else {
      if (c == 0x33 && !progmode) {
        progmode = true;
        digitalWrite(PROGMODE_LED, HIGH);
        Serial1.write(PROG_ACK);

      } else {
        progstart1 = false;
        Serial1.write(PROG_NACK);
      }
    }
  }

  if (progmode) {
    progbufptr = 0;
    progbufsz = 0;
  }

  while (progmode) {
    if (Serial1.available()) {
      uint8_t c = Serial1.read();

      digitalWrite(PROGMODE_LED, !digitalRead(PROGMODE_LED));

      progbuf[progbufptr++] = c;

      if (progend1) {
        if (c == PROG_END2) {
          progmode = false;
          progend1 = false;
          progstart1 = false;
          progbufsz = progbufptr - 2;
          progbufptr = 0;
          digitalWrite(PROGMODE_LED, LOW);
          Serial1.write(PROG_END_ACK);
        } else {
          progend1 = false;
          Serial1.write(PROG_ACK);
        }
      } else {
        if (c == PROG_END1) {
          progend1 = true;
        }

        Serial1.write(PROG_ACK);
      }
    }
  }

  digitalWrite(WAIT, HIGH);
}
